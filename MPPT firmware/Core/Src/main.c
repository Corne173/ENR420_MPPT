/* USER CODE BEGIN Header */
/*
 * Teaching overview
 * -----------------
 * This file is the top-level firmware scaffold for the MPPT practical. It ties
 * together the STM32 peripherals generated by CubeMX, the converter state
 * machine, ADC measurement conversion, PWM gate-driver control, serial commands,
 * and the student MPPT algorithm hook.
 *
 * The most important point for students is separation of responsibilities:
 *   - ADC code measures the PV/input and output quantities.
 *   - The state machine decides when switching is allowed.
 *   - Power-stage functions are the only functions that touch PWM and driver
 *     enable pins.
 *   - Mppt_CalculateDuty() is the intended place to add the MPPT algorithm.
 *
 */
/* USER CODE END Header */
/* Includes ------------------------------------------------------------------*/
#include "main.h"
#include "adc.h"
#include "tim.h"
#include "usart.h"
#include "gpio.h"

/* Private includes ----------------------------------------------------------*/
/* USER CODE BEGIN Includes */
#include "IrradianceSensor.h"
#include "Measurements.h"
#include "MpptController.h"
#include "PowerStage.h"
#include "SerialConsole.h"
#include "StatusLed.h"
#include "Telemetry.h"
#include "Timebase.h"
#include "TemperatureSensor.h"
/* USER CODE END Includes */

/* Private typedef -----------------------------------------------------------*/
/* USER CODE BEGIN PTD */

/* USER CODE END PTD */

/* Private define ------------------------------------------------------------*/
/* USER CODE BEGIN PD */

/*
 * Cooperative scheduler periods.
 *
 * The main loop has no RTOS. Instead, it calls short tasks when their elapsed
 * time has expired. Measurement/protection runs fastest; MPPT runs slower so
 * the converter can settle after a duty change; telemetry is rate-limited so
 * UART printing does not dominate the control loop.
 */
#define FAST_TASK_PERIOD_MS        (1U)
#define MPPT_TASK_PERIOD_MS        (50U)
#define TELEMETRY_TASK_PERIOD_MS   (50U)  /* 20 telemetry packets per second */
#define STARTUP_SETTLE_TIME_MS     (500U)



/* USER CODE END PD */

/* Private macro -------------------------------------------------------------*/
/* USER CODE BEGIN PM */

/* USER CODE END PM */

/* Private variables ---------------------------------------------------------*/

/* USER CODE BEGIN PV */

extern volatile bool mppt_start_requested;
extern volatile bool stop_requested;
extern volatile bool fault_reset_requested;

static uint32_t mppt_state_entered_ms;
static uint32_t fast_task_last_ms;
static uint32_t mppt_task_last_ms;
static uint32_t telemetry_task_last_ms;

volatile State_t state = STATE_INIT;
volatile Fault_t mppt_fault = FAULT_NONE;

/* USER CODE END PV */

/* Private function prototypes -----------------------------------------------*/
void SystemClock_Config(void);
/* USER CODE BEGIN PFP */

void setState(State_t next_state);
bool runFastTasks(void);
void MpptController_Task(void);
void controllerInit(void);



/* USER CODE END PFP */

/* Private user code ---------------------------------------------------------*/
/* USER CODE BEGIN 0 */



/* USER CODE END 0 */

/**
  * @brief  The application entry point.
  * @retval int
  */
int main(void)
{

  /* USER CODE BEGIN 1 */

  /* USER CODE END 1 */

  /* MCU Configuration--------------------------------------------------------*/

  /* Reset of all peripherals, Initializes the Flash interface and the Systick. */
  HAL_Init();

  /* USER CODE BEGIN Init */

  /* USER CODE END Init */

  /* Configure the system clock */
  SystemClock_Config();

  /* USER CODE BEGIN SysInit */

  /* USER CODE END SysInit */

  /* Initialize all configured peripherals */
  MX_GPIO_Init();
  MX_ADC1_Init();
  MX_ADC2_Init();
  MX_TIM1_Init();
  MX_USART1_UART_Init();
  MX_USART2_UART_Init();
  MX_TIM16_Init();
  MX_TIM3_Init();
  /* USER CODE BEGIN 2 */
  IrradianceSensor_Init();
  TemperatureSensor_Init();

  /* Start the PC console first so boot messages and fault states are visible. */
  SerialConsole_Init();
  SerialConsole_PrintBootMessage();

  /* Initialise the converter controller. This keeps the power stage disabled,
   * calibrates the ADCs, captures current-sensor offsets, and then enters IDLE. */
  controllerInit();
  SerialConsole_PrintStatus();
  /* USER CODE END 2 */

  /* Infinite loop */
  /* USER CODE BEGIN WHILE */
    /*
      * Cooperative super-loop.
      *
      * There is no operating system here. Each task must return quickly so the
      * next task can run on time. Avoid long blocking delays inside this loop.
      */

  while (1)
  {
    /* USER CODE END WHILE */

    /* USER CODE BEGIN 3 */
    const uint32_t now_ms = HAL_GetTick();

    /* Runs measurement, protection, state transitions, and MPPT updates. */
    #if 1
    

    /* Fast task: refresh measurements and perform simple feedback validity checks. */
    if (Timebase_HasElapsed(now_ms, fast_task_last_ms, FAST_TASK_PERIOD_MS))
    {
      fast_task_last_ms = now_ms;
      (void)runFastTasks();
    }

    /* Handle console commands after the safety-critical measurement checks. */
    SerialConsole_Task();

    switch ((State_t)state)
    {
      case STATE_INIT:
        /* If the controller ever reaches INIT after boot, return to a safe idle state. */
        setState(STATE_IDLE);
        break;

      case STATE_IDLE:
        /* IDLE is the safe waiting state. A start request is accepted only when
        * the latest ADC readings are valid and not saturated. */
        if (mppt_start_requested)
        {
          mppt_start_requested = false;
          if (Measurements_AreInAdcRange(Measurements_GetLatest()))
          {
            setState(STATE_MPPT_STARTUP);
          }
          else
          {
            const Measurements_t *measurements = Measurements_GetLatest();
            const Fault_t acquisition_fault = Measurements_GetAcquisitionFault();
            if (!measurements->valid)
            {
              enterFault((acquisition_fault != FAULT_NONE) ? acquisition_fault
                                                           : FAULT_ADC_READ);
            }
            else
            {
              enterFault(FAULT_ADC_RANGE);
            }
          }
        }
        break;

      case STATE_MPPT_STARTUP:
        /* STARTUP applies a small known duty command and waits for the converter
        * to settle before handing control to the student MPPT algorithm. */
        if (stop_requested)
        {
          stop_requested = false;
          setState(STATE_IDLE);
        }
        else if (Timebase_HasElapsed(now_ms, mppt_state_entered_ms, STARTUP_SETTLE_TIME_MS))
        {
          setState(STATE_MPPT_RUN);
        }
        break;

      case STATE_MPPT_RUN:
        /* RUN executes the MPPT algorithm at a medium rate. The duty cycle is not
        * updated every loop iteration, because the power stage and ADC readings
        * need time to respond after each command change. */
        if (stop_requested)
        {
          stop_requested = false;
          setState(STATE_IDLE);
          break;
        }

        if (Timebase_HasElapsed(now_ms, mppt_task_last_ms, MPPT_TASK_PERIOD_MS))
        {
          mppt_task_last_ms = now_ms;
          MpptController_Update();
        }

        break;

      case STATE_FAULT:
      default:
        /* FAULT is latched. Keep switching disabled until a deliberate reset request. */
        PowerStage_Disable();
        if (fault_reset_requested)
        {
          fault_reset_requested= false;
          stop_requested = false;
          mppt_start_requested = false;
          mppt_fault = FAULT_NONE;
          /* Rebuild the complete measurement chain instead of merely clearing
           * the visible fault and immediately tripping again on a stopped DMA. */
          controllerInit();
        }
        break;
    }
    #endif

    /* Sensor tasks only advance their state machines and never wait in the loop. */
    TemperatureSensor_Task();
    IrradianceSensor_Task();

    /* Queue telemetry after control and sensor state have been serviced. */
    if (Timebase_HasElapsed(now_ms, telemetry_task_last_ms, TELEMETRY_TASK_PERIOD_MS))
    {
      telemetry_task_last_ms = now_ms;
      Telemetry_Task();
    }

    /* Test-only status indication on LD3/PB3. See the warning in the function. */
    StatusLed_Task(state);
  }
  /* USER CODE END 3 */
}

/**
  * @brief System Clock Configuration
  * @retval None
  */
void SystemClock_Config(void)
{
  RCC_OscInitTypeDef RCC_OscInitStruct = {0};
  RCC_ClkInitTypeDef RCC_ClkInitStruct = {0};
  RCC_PeriphCLKInitTypeDef PeriphClkInit = {0};

  /** Initializes the RCC Oscillators according to the specified parameters
  * in the RCC_OscInitTypeDef structure.
  */
  RCC_OscInitStruct.OscillatorType = RCC_OSCILLATORTYPE_HSI;
  RCC_OscInitStruct.HSIState = RCC_HSI_ON;
  RCC_OscInitStruct.HSICalibrationValue = RCC_HSICALIBRATION_DEFAULT;
  RCC_OscInitStruct.PLL.PLLState = RCC_PLL_ON;
  RCC_OscInitStruct.PLL.PLLSource = RCC_PLLSOURCE_HSI;
  RCC_OscInitStruct.PLL.PLLMUL = RCC_PLL_MUL16;
  if (HAL_RCC_OscConfig(&RCC_OscInitStruct) != HAL_OK)
  {
    Error_Handler();
  }

  /** Initializes the CPU, AHB and APB buses clocks
  */
  RCC_ClkInitStruct.ClockType = RCC_CLOCKTYPE_HCLK|RCC_CLOCKTYPE_SYSCLK
                              |RCC_CLOCKTYPE_PCLK1|RCC_CLOCKTYPE_PCLK2;
  RCC_ClkInitStruct.SYSCLKSource = RCC_SYSCLKSOURCE_PLLCLK;
  RCC_ClkInitStruct.AHBCLKDivider = RCC_SYSCLK_DIV1;
  RCC_ClkInitStruct.APB1CLKDivider = RCC_HCLK_DIV2;
  RCC_ClkInitStruct.APB2CLKDivider = RCC_HCLK_DIV1;

  if (HAL_RCC_ClockConfig(&RCC_ClkInitStruct, FLASH_LATENCY_2) != HAL_OK)
  {
    Error_Handler();
  }
  PeriphClkInit.PeriphClockSelection = RCC_PERIPHCLK_USART1|RCC_PERIPHCLK_TIM1;
  PeriphClkInit.Usart1ClockSelection = RCC_USART1CLKSOURCE_SYSCLK;
  PeriphClkInit.Tim1ClockSelection = RCC_TIM1CLK_PLLCLK;
  if (HAL_RCCEx_PeriphCLKConfig(&PeriphClkInit) != HAL_OK)
  {
    Error_Handler();
  }
}

/* USER CODE BEGIN 4 */

//Change to converter initialisation
void controllerInit(void)
{
  Fault_t acquisition_fault;

  /* The first firmware action for the converter controller is always safe output. */
  PowerStage_Disable();

  /* Calibration requires disabled ADCs. This is also the cleanup path when a
   * deliberate fault reset restarts acquisition after a DMA/ADC failure. */
  Measurements_StopSynchronized();

  /* ADC calibration compensates internal ADC errors before readings are trusted. */
  if (HAL_ADCEx_Calibration_Start(&hadc1, ADC_SINGLE_ENDED) != HAL_OK)
  {
    enterFault(FAULT_ADC1_CALIBRATION);
    return;
  }
  if (HAL_ADCEx_Calibration_Start(&hadc2, ADC_SINGLE_ENDED) != HAL_OK)
  {
    enterFault(FAULT_ADC2_CALIBRATION);
    return;
  }

  /* Arm both independent DMA streams before TIM1 starts their shared CC3 trigger.
   * The helper waits for complete buffers and publishes the first measurement. */
  acquisition_fault = Measurements_StartSynchronized();
  if (acquisition_fault != FAULT_NONE)
  {
    enterFault(acquisition_fault);
    return;
  }

  /* Store the no-load current-sensor levels from PWM-synchronised samples. */
  Measurements_CaptureZeroCurrentOffsets();

  /* Re-read after offset capture so converted current values use the new offsets. */
  if (!Measurements_Update())
  {
    acquisition_fault = Measurements_GetAcquisitionFault();
    enterFault((acquisition_fault != FAULT_NONE) ? acquisition_fault
                                                 : FAULT_ADC_READ);
    return;
  }
  setState(STATE_IDLE);
}

/**
  * @brief  Enters a new converter state and performs the required entry action.
  * @param  next_state State to enter.
  */
void setState(State_t next_state)
{
  state = next_state;
  mppt_state_entered_ms = HAL_GetTick();

  switch (next_state)
  {
    case STATE_INIT:
    case STATE_IDLE:
      /* In non-switching states, force the converter outputs to the safe state. */
      PowerStage_Disable();
      break;

    case STATE_MPPT_STARTUP:
      MpptController_Startup();
      break;

    case STATE_MPPT_RUN:
      /* RUN keeps the PWM hardware enabled. MpptController_Update() later changes compare values. */
      if (!PowerStage_Enable())
      {
        enterFault(FAULT_PWM_START);
      }
      break;

    case STATE_FAULT:
    default:
      /* Any unknown state is treated as a fault-like condition. */
      PowerStage_Disable();
      break;
  }
}

void requestMpptStart(void)
{
  mppt_start_requested = true;
  stop_requested = false;
}

void requestStop(void)
{
  stop_requested = true;
  mppt_start_requested = false;
}

void requestFaultReset(void)
{
  fault_reset_requested= true;
}

State_t getState(void)
{
  return (State_t)state;
}

Fault_t getFault(void)
{
  return (Fault_t)mppt_fault;
}

/**
  * @brief  Latches the fault reason and immediately moves the converter to FAULT.
  * @param  fault Fault code to store for debugging or telemetry.
  */
void enterFault(Fault_t fault)
{
  /* Store the cause before changing state so it can be printed and debugged. */
  mppt_fault = fault;
  setState(STATE_FAULT);
}

/**
  * @brief  Runs high-rate measurement and protection checks.
  * @retval true when fast tasks completed without tripping a fault.
  */
bool runFastTasks(void)
{
  const State_t current_state = (State_t)state;

  /* A failed ADC update means the controller no longer knows the converter state. */
  if (!Measurements_Update())
  {
    if (current_state != STATE_FAULT)
    {
      const Fault_t acquisition_fault = Measurements_GetAcquisitionFault();
      enterFault((acquisition_fault != FAULT_NONE) ? acquisition_fault
                                                   : FAULT_ADC_READ);
      return false;
    }

    return false;
  }

  /* Saturated ADC values are treated as invalid feedback while switching is active. */
  if (((current_state == STATE_MPPT_STARTUP) || (current_state == STATE_MPPT_RUN)) &&
      !Measurements_AreInAdcRange(Measurements_GetLatest()))
  {
    enterFault(FAULT_ADC_RANGE);
    return false;
  }

  return true;
}



/**
 * @brief  UART transmit-complete callback dispatches to the active UART module.
 * @param  huart UART handle that completed transmission.
 */
void HAL_UART_TxCpltCallback(UART_HandleTypeDef *huart)
{
  IrradianceSensor_TxCpltCallback(huart);
  SerialConsole_TxCpltCallback(huart);
}

/**
 * @brief  UART receive-complete callback dispatches to the active UART module.
 * @param  huart UART handle that completed reception.
 */
void HAL_UART_RxCpltCallback(UART_HandleTypeDef *huart)
{
  IrradianceSensor_RxCpltCallback(huart);
  SerialConsole_RxCpltCallback(huart);
}

/**
 * @brief  UART error callback dispatches to the active UART module.
 * @param  huart UART handle that reported an error.
 */
void HAL_UART_ErrorCallback(UART_HandleTypeDef *huart)
{
  IrradianceSensor_ErrorCallback(huart);
  SerialConsole_ErrorCallback(huart);
}

/**
  * @brief  Returns a text label for an MPPT state.
  * @param  state MPPT state.
  * @retval Constant string for serial status output.
  */
const char *getStateName(State_t state)
{
  switch (state)
  {
    case STATE_INIT:
      return "INIT";
    case STATE_IDLE:
      return "IDLE";
    case STATE_MPPT_STARTUP:
      return "STARTUP";
    case STATE_MPPT_RUN:
      return "RUN";
    case STATE_FAULT:
      return "FAULT";
    default:
      return "UNKNOWN";
  }
}

/**
  * @brief  Returns a text label for an MPPT fault code.
  * @param  fault MPPT fault code.
  * @retval Constant string for serial status output.
  */
const char *getFaultName(Fault_t fault)
{
  switch (fault)
  {
    case FAULT_NONE:
      return "NONE";
    case FAULT_ADC1_CALIBRATION:
      return "ADC1_CAL";
    case FAULT_ADC2_CALIBRATION:
      return "ADC2_CAL";
    case FAULT_ADC1_DMA_START:
      return "ADC1_DMA_START";
    case FAULT_ADC2_DMA_START:
      return "ADC2_DMA_START";
    case FAULT_ADC_TRIGGER_START:
      return "ADC_TRIGGER_START";
    case FAULT_ADC_TRIGGER_LOST:
      return "ADC_TRIGGER_LOST";
    case FAULT_ADC1_FIRST_BUFFER:
      return "ADC1_NO_BUFFER";
    case FAULT_ADC2_FIRST_BUFFER:
      return "ADC2_NO_BUFFER";
    case FAULT_ADC_BOTH_FIRST_BUFFER:
      return "ADC_BOTH_NO_BUFFER";
    case FAULT_ADC1_OVERRUN:
      return "ADC1_OVERRUN";
    case FAULT_ADC2_OVERRUN:
      return "ADC2_OVERRUN";
    case FAULT_ADC1_DMA_TRANSFER:
      return "ADC1_DMA_TRANSFER";
    case FAULT_ADC2_DMA_TRANSFER:
      return "ADC2_DMA_TRANSFER";
    case FAULT_ADC1_INTERNAL:
      return "ADC1_INTERNAL";
    case FAULT_ADC2_INTERNAL:
      return "ADC2_INTERNAL";
    case FAULT_ADC1_STALE:
      return "ADC1_STALE";
    case FAULT_ADC2_STALE:
      return "ADC2_STALE";
    case FAULT_ADC_SNAPSHOT:
      return "ADC_SNAPSHOT";
    case FAULT_ADC_READ:
      return "ADC_READ";
    case FAULT_ADC_RANGE:
      return "ADC_RANGE";
    case FAULT_PWM_START:
      return "PWM_START";
    default:
      return "UNKNOWN";
  }
}

/* USER CODE END 4 */

/**
  * @brief  This function is executed in case of error occurrence.
  * @retval None
  */
void Error_Handler(void)
{
  /* USER CODE BEGIN Error_Handler_Debug */
  /* User can add his own implementation to report the HAL error return state */
  __disable_irq();
  while (1)
  {
  }
  /* USER CODE END Error_Handler_Debug */
}
#ifdef USE_FULL_ASSERT
/**
  * @brief  Reports the name of the source file and the source line number
  *         where the assert_param error has occurred.
  * @param  file: pointer to the source file name
  * @param  line: assert_param error line source number
  * @retval None
  */
void assert_failed(uint8_t *file, uint32_t line)
{
  /* USER CODE BEGIN 6 */
  /* User can add his own implementation to report the file name and line number,
     ex: printf("Wrong parameters value: file %s on line %d\r\n", file, line) */
  /* USER CODE END 6 */
}
#endif /* USE_FULL_ASSERT */
